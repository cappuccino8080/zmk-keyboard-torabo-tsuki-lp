#include <input/processors.dtsi>

&pointing_listener {
    status = "okay";
    device = <&pointing_device>;

    /*
     * トラックボールに合わせて、XY軸を反転させる。
     * トラックボールを動かしたら Layer4 を 3秒間有効化する。
     */
    input-processors =
        <&zip_xy_transform (INPUT_TRANSFORM_X_INVERT | INPUT_TRANSFORM_Y_INVERT)>,
        <&zip_temp_layer 4 3000>;

    /*
     * Layer5 が有効な間だけ、トラックボール移動をスクロールに変換する。
     */
    scroll_layer {
        layers = <5>;
        input-processors =   <&zip_xy_scaler 1 3>,                             // 移動量を 1/3 に減衰
                             <&zip_xy_to_scroll_mapper>,                       // XYをスクロールに変換
                             <&zip_scroll_transform INPUT_TRANSFORM_X_INVERT>; // X軸反転
    };
};

&zip_temp_layer {
    excluded-positions = <
        33  // Mouse button 1 (J)
        34  // Mouse button 3 (K)
        35  // Mouse button 2 (L)
        47  // Mouse button 4 (M)
        49  // Mouse button 5 (.)
        60  // Enter キー (誤爆防止)
    >;
    require-prior-idle-ms = <500>;
};